## config/west.yml
```yaml
manifest:
  remotes:
    - name: zmk
      url-base: https://github.com/zmkfirmware
    - name: zmk
      url-base: https://github.com/yangxing844
    - name: badjeff
      url-base: https://github.com/badjeff
  projects:
    - name: zmk
      remote: yangxing844
      revision: main
      import: app/west.yml
    - name: zmk-analog-input-driver
      remote: badjeff
      revision: main
  self:
    path: config
```
